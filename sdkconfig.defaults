## tools/ble-probe/sdkconfig.defaults
```kconfig
# 探针自己的配置：它不跟产品固件共用 sdkconfig，所以怎么改都不会影响 app 的构建。
CONFIG_IDF_TARGET="esp32c3"
CONFIG_ESPTOOLPY_FLASHSIZE_8MB=y
CONFIG_ESP_CONSOLE_USB_SERIAL_JTAG=y
CONFIG_ESP_CONSOLE_UART_DEFAULT=n

# --- NimBLE：单连接 peripheral，配对要认证、要留 bond ---
CONFIG_BT_ENABLED=y
CONFIG_BT_NIMBLE_ENABLED=y
CONFIG_BT_NIMBLE_ROLE_CENTRAL=n
CONFIG_BT_NIMBLE_ROLE_PERIPHERAL=y
CONFIG_BT_NIMBLE_ROLE_BROADCASTER=y
CONFIG_BT_NIMBLE_ROLE_OBSERVER=n
CONFIG_BT_NIMBLE_MAX_CONNECTIONS=1

# 这三条是设计的一部分，探针要一起验：
#   NVS_PERSIST：bond 跨重启存活（默认 n —— 关着的话「重连免配对」根本不可能成立）
#   MAX_BONDS=1：只认一台电脑（新配对顶掉旧的）
#   HANDLE_REPEAT_PAIRING_DELETION：对方删了 bond 再来配对时，本机把陈旧的那条也删掉
#     （默认 n，正是「换电脑」时最经典的死锁）
CONFIG_BT_NIMBLE_NVS_PERSIST=y
CONFIG_BT_NIMBLE_MAX_BONDS=1
CONFIG_BT_NIMBLE_HANDLE_REPEAT_PAIRING_DELETION=y
```
